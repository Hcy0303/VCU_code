/******************************************************************************
* ASAP2 file: front_0505.a2l
* Academic License - for use in teaching, academic research, and meeting
* course requirements at degree granting institutions only. Not for
* government, commercial, or other organizational use.
* Code generation for model "front_0505".
* Model version : 9.346
* Simulink Coder version : 9.8 (R2022b) 13-May-2022
* C source code generated on : Sat Nov 1 21:37:31 2025
* Target selection: EcoCoderTC27x.tlc
* Embedded hardware selection: Infineon->TriCore
* Code generation objectives: Unspecified
* Validation result: Not run
* (add additional file header information here)
******************************************************************************/ ASAP2_VERSION 1 31
/* Version 1.31 */
/begin PROJECT ProjectName "Project Comment Goes Here"
/begin HEADER "Header Comments go here" /end HEADER
/begin MODULE ModuleName "Module Comment Goes Here"
/* EcoCoder V2.9.11 R2 Target:EV22297A verCalTool:0.0*/
/* XCP-En:0 XCPCalTool:CANape CANape XCP-CAN:CAN_CTRL_C XCP-CAN-Baud:500kbps*/
/* CCP-En:1 CCP-TYPE:Configurable CCPCalTool:CANape CCP-CAN:CAN_CTRL_B CCP-CAN-Baud:500kbps*/
/*PGCANAEn:NoUse PGCANAStation:NoUse PGCANABaud:250kbps PGCANACRO:NoUse PGCANADTO:NoUse*/
/*PGCANBEn:NoUse PGCANBStation:NoUse PGCANBBaud:500kbps PGCANBCRO:NoUse PGCANBDTO:NoUse*/
/*PGCANCEn:NoUse PGCANCStation:NoUse PGCANCBaud:500kbps PGCANCCRO:NoUse PGCANCDTO:NoUse*/
/*PGCANDEn:NoUse PGCANDStation:NoUse PGCANDBaud:500kbps PGCANDCRO:NoUse PGCANDDTO:NoUse*/
/*ECO_XCP_Note_Start
/begin IF_DATA XCP
/begin PROTOCOL_LAYER
0x0100
0x07D0
0x2710
0x3E8
0x2710
0x3E8
0x19
0x19
0x08
0x08
BYTE_ORDER_MSB_LAST
ADDRESS_GRANULARITY_BYTE
OPTIONAL_CMD ALLOC_ODT_ENTRY
OPTIONAL_CMD ALLOC_ODT
OPTIONAL_CMD ALLOC_DAQ
OPTIONAL_CMD FREE_DAQ
OPTIONAL_CMD GET_DAQ_EVENT_INFO
OPTIONAL_CMD GET_DAQ_RESOLUTION_INFO
OPTIONAL_CMD GET_DAQ_PROCESSOR_INFO
OPTIONAL_CMD START_STOP_SYNCH
OPTIONAL_CMD START_STOP_DAQ_LIST
OPTIONAL_CMD GET_DAQ_LIST_MODE
OPTIONAL_CMD SET_DAQ_LIST_MODE
OPTIONAL_CMD WRITE_DAQ
OPTIONAL_CMD SET_DAQ_PTR
OPTIONAL_CMD CLEAR_DAQ_LIST
OPTIONAL_CMD DOWNLOAD
OPTIONAL_CMD SHORT_UPLOAD
OPTIONAL_CMD UPLOAD
OPTIONAL_CMD SET_MTA
OPTIONAL_CMD UNLOCK
OPTIONAL_CMD GET_SEED
OPTIONAL_CMD GET_ID
OPTIONAL_CMD GET_COMM_MODE_INFO
OPTIONAL_CMD BUILD_CHECKSUM
SEED_AND_KEY_EXTERNAL_FUNCTION ""
/end PROTOCOL_LAYER
/begin DAQ
DYNAMIC
0x00
0x05
0x00
OPTIMISATION_TYPE_DEFAULT
ADDRESS_EXTENSION_FREE
IDENTIFICATION_FIELD_TYPE_ABSOLUTE
GRANULARITY_ODT_ENTRY_SIZE_DAQ_BYTE
0x07
OVERLOAD_INDICATION_PID
/begin STIM
GRANULARITY_ODT_ENTRY_SIZE_STIM_BYTE
0x07
/end STIM
/begin EVENT
"5ms"
"5ms"
0x00
DAQ
0x01
0x05
0x06
0x00
/end EVENT
/begin EVENT
"20ms"
"20ms"
0x01
DAQ
0x01
0x02
0x07
0x00
/end EVENT
/begin EVENT
"50ms"
"50ms"
0x02
DAQ
0x01
0x05
0x07
0x00
/end EVENT
/begin EVENT
"100ms"
"100ms"
0x03
DAQ
0x01
0x01
0x08
0x00
/end EVENT
/begin EVENT
"200ms"
"200m"
0x04
DAQ
0x01
0x02
0x08
0x00
/end EVENT
/end DAQ
/begin PAG
0x00
/end PAG
/begin PGM
PGM_MODE_ABSOLUTE
0x00
0x00
/end PGM
/begin XCP_ON_CAN
0x0100
CAN_ID_MASTER 0x200
CAN_ID_SLAVE 0x201
BAUDRATE 500000
SAMPLE_POINT 0x4B
SAMPLE_RATE SINGLE
BTL_CYCLES 0x08
SJW 0x02
SYNC_EDGE SINGLE
/end XCP_ON_CAN
/end IF_DATA
/begin IF_DATA CANAPE_ADDRESS_UPDATE
/end IF_DATA
/begin MOD_PAR "_default_ModParComment"
/begin MEMORY_SEGMENT _ROMCAL
"calibration_rom"
DATA
FLASH
INTERN
0x80238000
0x8000
-1 -1 -1 -1 -1
/begin IF_DATA XCP
/begin SEGMENT
0x00
0x01
0x00
0x00
0x00
/begin CHECKSUM
XCP_CRC_16_CITT
MAX_BLOCK_SIZE 0xFFFF
EXTERNAL_FUNCTION "String.Empty"
/end CHECKSUM
/begin PAGE
0x00
ECU_ACCESS_DONT_CARE
XCP_READ_ACCESS_DONT_CARE
XCP_WRITE_ACCESS_DONT_CARE
INIT_SEGMENT 0x00
/end PAGE
/begin ADDRESS_MAPPING
0x80238000
0x60000000
0x8000
/end ADDRESS_MAPPING
/end SEGMENT
/end IF_DATA
/end MEMORY_SEGMENT
/begin MEMORY_SEGMENT _CODE
"ecu_code"
CODE
FLASH
INTERN
0x80010000
0x001EFFFF
-1 -1 -1 -1 -1
/end MEMORY_SEGMENT
/end MOD_PAR
ECO_XCP_Note_End*/
/*ECO_CCP_Note_Start*/
/begin MOD_PAR "_default_ModParComment" ADDR_EPK 0x80234000 EPK "EV22297A V2.01.13 EcoCoder V2.9.11 R2 2025-11-01 21:37:32" /*EcoCoderINCAStart
/begin MEMORY_SEGMENT _RAMCAL
"calibration_ram"
DATA
RAM
INTERN
0x60000000
0x8000
-1 -1 -1 -1 -1
/end MEMORY_SEGMENT
EcoCoderINCAEnd*/
 /begin MEMORY_SEGMENT _ROMCAL "calibration_rom" DATA FLASH INTERN 0x80238000 0x8000 -1 -1 -1 -1 -1
  /begin IF_DATA ASAP1B_CCP /*EcoCoderINCAStart
ADDRESS_MAPPING 0x80238000 0x60000000 0x8000
EcoCoderINCAEnd*/ ADDR_MAPPING 0x80238000 0x60000000 0x8000 /end IF_DATA
 /end MEMORY_SEGMENT
 /begin MEMORY_SEGMENT _epk_data "epk_data" DATA FLASH INTERN 0x80234000 0xFF -1 -1 -1 -1 -1
  /begin IF_DATA ASAP1B_CCP /*EcoCoderINCAStart
ADDRESS_MAPPING 0x80234000 0x80234000 0xFF
EcoCoderINCAEnd*/ ADDR_MAPPING 0x80234000 0x80234000 0xFF /end IF_DATA
 /end MEMORY_SEGMENT
 /begin MEMORY_SEGMENT _CODE "ecu_code" CODE FLASH INTERN 0x80010000 0x001EFFFF -1 -1 -1 -1 -1 /end MEMORY_SEGMENT
/end MOD_PAR
/begin IF_DATA ASAP1B_CCP
 /begin SOURCE "10ms" 3 10 DISPLAY_IDENTIFIER DAQ0
  /begin QP_BLOB 0 LENGTH 0xA CAN_ID_FIXED 0x210 RASTER 0 REDUCTION_ALLOWED FIRST_PID 0x0 /end QP_BLOB
 /end SOURCE
 /begin SOURCE "20ms" 3 20 DISPLAY_IDENTIFIER DAQ2
  /begin QP_BLOB 1 LENGTH 0x20 CAN_ID_FIXED 0x211 RASTER 1 REDUCTION_ALLOWED FIRST_PID 0x0 /end QP_BLOB
 /end SOURCE
 /begin SOURCE "100ms" 3 100 DISPLAY_IDENTIFIER DAQ3
  /begin QP_BLOB 2 LENGTH 0x30 CAN_ID_FIXED 0x212 RASTER 2 REDUCTION_ALLOWED FIRST_PID 0x0 /end QP_BLOB
 /end SOURCE
 /begin SOURCE "200ms" 3 200 DISPLAY_IDENTIFIER DAQ3
  /begin QP_BLOB 3 LENGTH 0x50 CAN_ID_FIXED 0x213 RASTER 3 REDUCTION_ALLOWED FIRST_PID 0x0 /end QP_BLOB
 /end SOURCE
 /begin RASTER "10ms" "10ms" 0 3 10 /end RASTER
 /begin RASTER "20ms" "20ms" 1 3 20 /end RASTER
 /begin RASTER "100ms" "100ms" 2 3 100 /end RASTER
 /begin RASTER "200ms" "200ms" 3 3 200 /end RASTER
 /begin SEED_KEY "" "" "" /end SEED_KEY
 /begin CHECKSUM "CRC16.dll" /end CHECKSUM
 /begin TP_BLOB 0x0201 0x0204 0x200 0x201 0x112 1 BAUDRATE 500000 SAMPLE_POINT 70 SAMPLE_RATE 1 BTL_CYCLES 10 SJW 1 SYNC_EDGE SINGLE DAQ_MODE 0 CONSISTENCY 1 ADDRESS_EXTENSION 0 RESUME_SUPPORTED STORE_SUPPORTED
  /begin CHECKSUM_PARAM /*EcoCoderINCAStart
0x9001
EcoCoderINCAEnd*/ 0x0C 0xffffffff CHECKSUM_CALCULATION ACTIVE_PAGE /end CHECKSUM_PARAM
  /begin DEFINED_PAGES 0x00 "RAM_PAGE" 0x00 0x60000000 0x8000 RAM RAM_INIT_BY_ECU /end DEFINED_PAGES
  OPTIONAL_CMD 0X5 OPTIONAL_CMD 0X8 OPTIONAL_CMD 0X9 OPTIONAL_CMD 0XC OPTIONAL_CMD 0XD OPTIONAL_CMD 0XE OPTIONAL_CMD 0XF OPTIONAL_CMD 0X10 OPTIONAL_CMD 0X11 OPTIONAL_CMD 0X12 OPTIONAL_CMD 0X13 OPTIONAL_CMD 0X18 OPTIONAL_CMD 0X19 OPTIONAL_CMD 0X20 OPTIONAL_CMD 0X21 OPTIONAL_CMD 0X22 OPTIONAL_CMD 0X23 /end TP_BLOB
/end IF_DATA
/*ECO_CCP_Note_End*/
/begin MOD_COMMON "" /* Comment */ ALIGNMENT_BYTE 1 ALIGNMENT_WORD 1 ALIGNMENT_LONG 1 ALIGNMENT_FLOAT32_IEEE 1 ALIGNMENT_FLOAT64_IEEE 1 BYTE_ORDER MSB_LAST DEPOSIT ABSOLUTE /end MOD_COMMON
/begin RECORD_LAYOUT Scalar_BOOLEAN FNC_VALUES 1 UBYTE COLUMN_DIR DIRECT /end RECORD_LAYOUT
/begin RECORD_LAYOUT Scalar_UBYTE FNC_VALUES 1 UBYTE COLUMN_DIR DIRECT /end RECORD_LAYOUT
/begin RECORD_LAYOUT Scalar_BYTE FNC_VALUES 1 SBYTE COLUMN_DIR DIRECT /end RECORD_LAYOUT
/begin RECORD_LAYOUT Scalar_UWORD FNC_VALUES 1 UWORD COLUMN_DIR DIRECT /end RECORD_LAYOUT
/begin RECORD_LAYOUT Scalar_SWORD FNC_VALUES 1 SWORD COLUMN_DIR DIRECT /end RECORD_LAYOUT
/begin RECORD_LAYOUT Scalar_ULONG FNC_VALUES 1 ULONG COLUMN_DIR DIRECT /end RECORD_LAYOUT
/begin RECORD_LAYOUT Scalar_LONG FNC_VALUES 1 SLONG COLUMN_DIR DIRECT /end RECORD_LAYOUT
/begin RECORD_LAYOUT Scalar_FLOAT32_IEEE FNC_VALUES 1 FLOAT32_IEEE COLUMN_DIR DIRECT /end RECORD_LAYOUT
/begin RECORD_LAYOUT Scalar_FLOAT64_IEEE FNC_VALUES 1 FLOAT64_IEEE COLUMN_DIR DIRECT /end RECORD_LAYOUT
/begin RECORD_LAYOUT Lookup1D_BOOLEAN FNC_VALUES 1 UBYTE COLUMN_DIR DIRECT /end RECORD_LAYOUT
/begin RECORD_LAYOUT Lookup1D_X_BOOLEAN AXIS_PTS_X 1 UBYTE INDEX_INCR DIRECT /end RECORD_LAYOUT
/begin RECORD_LAYOUT Lookup1D_BYTE FNC_VALUES 1 SBYTE COLUMN_DIR DIRECT /end RECORD_LAYOUT
/begin RECORD_LAYOUT Lookup1D_X_BYTE AXIS_PTS_X 1 SBYTE INDEX_INCR DIRECT /end RECORD_LAYOUT
/begin RECORD_LAYOUT Lookup1D_UBYTE FNC_VALUES 1 UBYTE COLUMN_DIR DIRECT /end RECORD_LAYOUT
/begin RECORD_LAYOUT Lookup1D_X_UBYTE AXIS_PTS_X 1 UBYTE INDEX_INCR DIRECT /end RECORD_LAYOUT
/begin RECORD_LAYOUT Lookup1D_UWORD FNC_VALUES 1 UWORD COLUMN_DIR DIRECT /end RECORD_LAYOUT
/begin RECORD_LAYOUT Lookup1D_X_UWORD AXIS_PTS_X 1 UWORD INDEX_INCR DIRECT /end RECORD_LAYOUT
/begin RECORD_LAYOUT Lookup1D_WORD FNC_VALUES 1 SWORD COLUMN_DIR DIRECT /end RECORD_LAYOUT
/begin RECORD_LAYOUT Lookup1D_X_WORD AXIS_PTS_X 1 SWORD INDEX_INCR DIRECT /end RECORD_LAYOUT
/begin RECORD_LAYOUT Lookup1D_ULONG FNC_VALUES 1 ULONG COLUMN_DIR DIRECT /end RECORD_LAYOUT
/begin RECORD_LAYOUT Lookup1D_X_ULONG AXIS_PTS_X 1 ULONG INDEX_INCR DIRECT /end RECORD_LAYOUT
/begin RECORD_LAYOUT Lookup1D_SLONG FNC_VALUES 1 SLONG COLUMN_DIR DIRECT /end RECORD_LAYOUT
/begin RECORD_LAYOUT Lookup1D_X_LONG AXIS_PTS_X 1 SLONG INDEX_INCR DIRECT /end RECORD_LAYOUT
/begin RECORD_LAYOUT Lookup1D_FLOAT32_IEEE FNC_VALUES 1 FLOAT32_IEEE COLUMN_DIR DIRECT /end RECORD_LAYOUT
/begin RECORD_LAYOUT Lookup1D_X_FLOAT32_IEEE AXIS_PTS_X 1 FLOAT32_IEEE INDEX_INCR DIRECT /end RECORD_LAYOUT
/begin RECORD_LAYOUT Lookup1D_FLOAT64_IEEE FNC_VALUES 1 FLOAT64_IEEE COLUMN_DIR DIRECT /end RECORD_LAYOUT
/begin RECORD_LAYOUT Lookup1D_X_FLOAT64_IEEE AXIS_PTS_X 1 FLOAT64_IEEE INDEX_INCR DIRECT /end RECORD_LAYOUT
/begin RECORD_LAYOUT Lookup2D_BOOLEAN FNC_VALUES 1 UBYTE COLUMN_DIR DIRECT /end RECORD_LAYOUT
/begin RECORD_LAYOUT Lookup2D_X_BOOLEAN AXIS_PTS_X 1 UBYTE INDEX_INCR DIRECT /end RECORD_LAYOUT
/begin RECORD_LAYOUT Lookup2D_UBYTE FNC_VALUES 1 UBYTE COLUMN_DIR DIRECT /end RECORD_LAYOUT
/begin RECORD_LAYOUT Lookup2D_X_UBYTE AXIS_PTS_X 1 UBYTE INDEX_INCR DIRECT /end RECORD_LAYOUT
/begin RECORD_LAYOUT Lookup2D_BYTE FNC_VALUES 1 SBYTE COLUMN_DIR DIRECT /end RECORD_LAYOUT
/begin RECORD_LAYOUT Lookup2D_X_BYTE AXIS_PTS_X 1 SBYTE INDEX_INCR DIRECT /end RECORD_LAYOUT
/begin RECORD_LAYOUT Lookup2D_UWORD FNC_VALUES 1 UWORD COLUMN_DIR DIRECT /end RECORD_LAYOUT
/begin RECORD_LAYOUT Lookup2D_X_UWORD AXIS_PTS_X 1 UWORD INDEX_INCR DIRECT /end RECORD_LAYOUT
/begin RECORD_LAYOUT Lookup2D_WORD FNC_VALUES 1 SWORD COLUMN_DIR DIRECT /end RECORD_LAYOUT
/begin RECORD_LAYOUT Lookup2D_X_WORD AXIS_PTS_X 1 SWORD INDEX_INCR DIRECT /end RECORD_LAYOUT
/begin RECORD_LAYOUT Lookup2D_ULONG FNC_VALUES 1 ULONG COLUMN_DIR DIRECT /end RECORD_LAYOUT
/begin RECORD_LAYOUT Lookup2D_X_ULONG AXIS_PTS_X 1 ULONG INDEX_INCR DIRECT /end RECORD_LAYOUT
/begin RECORD_LAYOUT Lookup2D_LONG FNC_VALUES 1 SLONG COLUMN_DIR DIRECT /end RECORD_LAYOUT
/begin RECORD_LAYOUT Lookup2D_X_LONG AXIS_PTS_X 1 SLONG INDEX_INCR DIRECT /end RECORD_LAYOUT
/begin RECORD_LAYOUT Lookup2D_FLOAT32_IEEE FNC_VALUES 1 FLOAT32_IEEE COLUMN_DIR DIRECT /end RECORD_LAYOUT
/begin RECORD_LAYOUT Lookup2D_X_FLOAT32_IEEE AXIS_PTS_X 1 FLOAT32_IEEE INDEX_INCR DIRECT /end RECORD_LAYOUT
/begin RECORD_LAYOUT Lookup2D_FLOAT64_IEEE FNC_VALUES 1 FLOAT64_IEEE COLUMN_DIR DIRECT /end RECORD_LAYOUT
/begin RECORD_LAYOUT Lookup2D_X_FLOAT64_IEEE AXIS_PTS_X 1 FLOAT64_IEEE INDEX_INCR DIRECT /end RECORD_LAYOUT
/begin CHARACTERISTIC errorset /* Long Identifier */ "" /* Type */ VALUE /* ECU Address */ 0x80238000 /* @ECU_Address@errorset@ */ /* Record Layout */ Scalar_BOOLEAN /* Maximum Difference */ 0 /* Conversion Method */ front_0505_CM_boolean /* Lower Limit */ 0 /* Upper Limit */ 1 /end CHARACTERISTIC
/begin MEASUREMENT brake_voltage__2 "" FLOAT32_IEEE front_0505_CM_single 0 0 -3.4E+38 3.4E+38 ECU_ADDRESS 0x5000021c /* @ECU_Address@brake_voltage__2@ */ /end MEASUREMENT
/begin MEASUREMENT brake_per_2 "" FLOAT32_IEEE front_0505_CM_single 0 0 -3.4E+38 3.4E+38 ECU_ADDRESS 0x50000224 /* @ECU_Address@brake_per_2@ */ /end MEASUREMENT
/begin MEASUREMENT Brake_angle_volt "" FLOAT32_IEEE front_0505_CM_single 0 0 -3.4E+38 3.4E+38 ECU_ADDRESS 0x500002e4 /* @ECU_Address@Brake_angle_volt@ */ /end MEASUREMENT
/begin MEASUREMENT KNOB_VOLTAGE "" FLOAT32_IEEE front_0505_CM_single 0 0 -3.4E+38 3.4E+38 ECU_ADDRESS 0x50000290 /* @ECU_Address@KNOB_VOLTAGE@ */ /end MEASUREMENT
/begin MEASUREMENT I "" FLOAT32_IEEE front_0505_CM_single 0 0 -3.4E+38 3.4E+38 ECU_ADDRESS 0x50000298 /* @ECU_Address@I@ */ /end MEASUREMENT
/begin MEASUREMENT DCDC_temp "" FLOAT32_IEEE front_0505_CM_single 0 0 -3.4E+38 3.4E+38 ECU_ADDRESS 0x500002dc /* @ECU_Address@DCDC_temp@ */ /end MEASUREMENT
/begin MEASUREMENT FL_Actual_Torque "" FLOAT32_IEEE front_0505_CM_single 0 0 -3.4E+38 3.4E+38 ECU_ADDRESS 0x500002d8 /* @ECU_Address@FL_Actual_Torque@ */ /end MEASUREMENT
/begin MEASUREMENT FR_Actual_Torque "" FLOAT32_IEEE front_0505_CM_single 0 0 -3.4E+38 3.4E+38 ECU_ADDRESS 0x500002b8 /* @ECU_Address@FR_Actual_Torque@ */ /end MEASUREMENT
/begin MEASUREMENT brake_voltage__1 "" FLOAT32_IEEE front_0505_CM_single 0 0 -3.4E+38 3.4E+38 ECU_ADDRESS 0x50000220 /* @ECU_Address@brake_voltage__1@ */ /end MEASUREMENT
/begin MEASUREMENT ACC_Pedal_ADC1 "" FLOAT32_IEEE front_0505_CM_single 0 0 -3.4E+38 3.4E+38 ECU_ADDRESS 0x500002f4 /* @ECU_Address@ACC_Pedal_ADC1@ */ /end MEASUREMENT
/begin MEASUREMENT ACC_Pedal_ADC2 "" FLOAT32_IEEE front_0505_CM_single 0 0 -3.4E+38 3.4E+38 ECU_ADDRESS 0x500002f0 /* @ECU_Address@ACC_Pedal_ADC2@ */ /end MEASUREMENT
/begin MEASUREMENT steering_volt "" FLOAT32_IEEE front_0505_CM_single 0 0 -3.4E+38 3.4E+38 ECU_ADDRESS 0x50000204 /* @ECU_Address@steering_volt@ */ /end MEASUREMENT
/begin MEASUREMENT steering_angle "" FLOAT32_IEEE front_0505_CM_single 0 0 -3.4E+38 3.4E+38 ECU_ADDRESS 0x50000208 /* @ECU_Address@steering_angle@ */ /end MEASUREMENT
/begin MEASUREMENT LV_volt "" FLOAT32_IEEE front_0505_CM_single 0 0 -3.4E+38 3.4E+38 ECU_ADDRESS 0x5000028c /* @ECU_Address@LV_volt@ */ /end MEASUREMENT
/begin MEASUREMENT percent_out "" FLOAT32_IEEE front_0505_CM_single 0 0 -3.4E+38 3.4E+38 ECU_ADDRESS 0x50000214 /* @ECU_Address@percent_out@ */ /end MEASUREMENT
/begin MEASUREMENT Pedal_percent "" FLOAT32_IEEE front_0505_CM_single 0 0 -3.4E+38 3.4E+38 ECU_ADDRESS 0x50000280 /* @ECU_Address@Pedal_percent@ */ /end MEASUREMENT
/begin MEASUREMENT ACC_per_l "" FLOAT32_IEEE front_0505_CM_single 0 0 -3.4E+38 3.4E+38 ECU_ADDRESS 0x500002e8 /* @ECU_Address@ACC_per_l@ */ /end MEASUREMENT
/begin MEASUREMENT Pedal_Unreliable "" FLOAT32_IEEE front_0505_CM_single 0 0 -3.4E+38 3.4E+38 ECU_ADDRESS 0x50000284 /* @ECU_Address@Pedal_Unreliable@ */ /end MEASUREMENT
/begin MEASUREMENT ACC_per_h "" FLOAT32_IEEE front_0505_CM_single 0 0 -3.4E+38 3.4E+38 ECU_ADDRESS 0x500002ec /* @ECU_Address@ACC_per_h@ */ /end MEASUREMENT
/begin MEASUREMENT brake_per_1 "" FLOAT32_IEEE front_0505_CM_single 0 0 -3.4E+38 3.4E+38 ECU_ADDRESS 0x50000228 /* @ECU_Address@brake_per_1@ */ /end MEASUREMENT
/begin MEASUREMENT RL_Actual_Torque "" FLOAT32_IEEE front_0505_CM_single 0 0 -3.4E+38 3.4E+38 ECU_ADDRESS 0x5000027c /* @ECU_Address@RL_Actual_Torque@ */ /end MEASUREMENT
/begin MEASUREMENT RR_Actual_Torque "" FLOAT32_IEEE front_0505_CM_single 0 0 -3.4E+38 3.4E+38 ECU_ADDRESS 0x5000025c /* @ECU_Address@RR_Actual_Torque@ */ /end MEASUREMENT
/begin MEASUREMENT SC_statement "" FLOAT32_IEEE front_0505_CM_single 0 0 -3.4E+38 3.4E+38 ECU_ADDRESS 0x5000023c /* @ECU_Address@SC_statement@ */ /end MEASUREMENT
/begin MEASUREMENT actual_velocity "" FLOAT32_IEEE front_0505_CM_single 0 0 -3.4E+38 3.4E+38 ECU_ADDRESS 0x5000022c /* @ECU_Address@actual_velocity@ */ /end MEASUREMENT
/begin MEASUREMENT RR_TempIGBT "" FLOAT32_IEEE front_0505_CM_single 0 0 -3.4E+38 3.4E+38 ECU_ADDRESS 0x5000024c /* @ECU_Address@RR_TempIGBT@ */ /end MEASUREMENT
/begin MEASUREMENT RR_TempInverter "" FLOAT32_IEEE front_0505_CM_single 0 0 -3.4E+38 3.4E+38 ECU_ADDRESS 0x50000248 /* @ECU_Address@RR_TempInverter@ */ /end MEASUREMENT
/begin MEASUREMENT RR_TempMotor "" FLOAT32_IEEE front_0505_CM_single 0 0 -3.4E+38 3.4E+38 ECU_ADDRESS 0x50000244 /* @ECU_Address@RR_TempMotor@ */ /end MEASUREMENT
/begin MEASUREMENT RL_TempIGBT "" FLOAT32_IEEE front_0505_CM_single 0 0 -3.4E+38 3.4E+38 ECU_ADDRESS 0x5000026c /* @ECU_Address@RL_TempIGBT@ */ /end MEASUREMENT
/begin MEASUREMENT RL_TempInverter "" FLOAT32_IEEE front_0505_CM_single 0 0 -3.4E+38 3.4E+38 ECU_ADDRESS 0x50000268 /* @ECU_Address@RL_TempInverter@ */ /end MEASUREMENT
/begin MEASUREMENT RL_TempMotor "" FLOAT32_IEEE front_0505_CM_single 0 0 -3.4E+38 3.4E+38 ECU_ADDRESS 0x50000264 /* @ECU_Address@RL_TempMotor@ */ /end MEASUREMENT
/begin MEASUREMENT FR_TempIGBT "" FLOAT32_IEEE front_0505_CM_single 0 0 -3.4E+38 3.4E+38 ECU_ADDRESS 0x500002a8 /* @ECU_Address@FR_TempIGBT@ */ /end MEASUREMENT
/begin MEASUREMENT FR_TempInverter "" FLOAT32_IEEE front_0505_CM_single 0 0 -3.4E+38 3.4E+38 ECU_ADDRESS 0x500002a4 /* @ECU_Address@FR_TempInverter@ */ /end MEASUREMENT
/begin MEASUREMENT FR_TempMotor "" FLOAT32_IEEE front_0505_CM_single 0 0 -3.4E+38 3.4E+38 ECU_ADDRESS 0x500002a0 /* @ECU_Address@FR_TempMotor@ */ /end MEASUREMENT
/begin MEASUREMENT FL_TempIGBT "" FLOAT32_IEEE front_0505_CM_single 0 0 -3.4E+38 3.4E+38 ECU_ADDRESS 0x500002c8 /* @ECU_Address@FL_TempIGBT@ */ /end MEASUREMENT
/begin MEASUREMENT FL_TempInverter "" FLOAT32_IEEE front_0505_CM_single 0 0 -3.4E+38 3.4E+38 ECU_ADDRESS 0x500002c4 /* @ECU_Address@FL_TempInverter@ */ /end MEASUREMENT
/begin MEASUREMENT FL_TempMotor "" FLOAT32_IEEE front_0505_CM_single 0 0 -3.4E+38 3.4E+38 ECU_ADDRESS 0x500002c0 /* @ECU_Address@FL_TempMotor@ */ /end MEASUREMENT
/begin MEASUREMENT Vehicle_Status "" FLOAT32_IEEE front_0505_CM_single 0 0 -3.4E+38 3.4E+38 ECU_ADDRESS 0x50000230 /* @ECU_Address@Vehicle_Status@ */ /end MEASUREMENT
/begin MEASUREMENT Multi_gear_knob "" UWORD front_0505_CM_uint16 0 0 0 65535 ECU_ADDRESS 0x50000288 /* @ECU_Address@Multi_gear_knob@ */ /end MEASUREMENT
/begin MEASUREMENT Torque_Set_FL "" UWORD front_0505_CM_uint16 0 0 0 65535 ECU_ADDRESS 0x5000023a /* @ECU_Address@Torque_Set_FL@ */ /end MEASUREMENT
/begin MEASUREMENT Torque_Set_FR "" UWORD front_0505_CM_uint16 0 0 0 65535 ECU_ADDRESS 0x50000238 /* @ECU_Address@Torque_Set_FR@ */ /end MEASUREMENT
/begin MEASUREMENT Torque_Set_RL "" UWORD front_0505_CM_uint16 0 0 0 65535 ECU_ADDRESS 0x50000236 /* @ECU_Address@Torque_Set_RL@ */ /end MEASUREMENT
/begin MEASUREMENT Torque_Set_RR "" UWORD front_0505_CM_uint16 0 0 0 65535 ECU_ADDRESS 0x50000234 /* @ECU_Address@Torque_Set_RR@ */ /end MEASUREMENT
/begin MEASUREMENT RR_Error_Info "" UWORD front_0505_CM_uint16 0 0 0 65535 ECU_ADDRESS 0x50000254 /* @ECU_Address@RR_Error_Info@ */ /end MEASUREMENT
/begin MEASUREMENT RL_Error_Info "" UWORD front_0505_CM_uint16 0 0 0 65535 ECU_ADDRESS 0x50000274 /* @ECU_Address@RL_Error_Info@ */ /end MEASUREMENT
/begin MEASUREMENT FR_Error_Info "" UWORD front_0505_CM_uint16 0 0 0 65535 ECU_ADDRESS 0x500002b0 /* @ECU_Address@FR_Error_Info@ */ /end MEASUREMENT
/begin MEASUREMENT FL_Error_Info "" UWORD front_0505_CM_uint16 0 0 0 65535 ECU_ADDRESS 0x500002d0 /* @ECU_Address@FL_Error_Info@ */ /end MEASUREMENT
/begin MEASUREMENT FL_Actual_Velocity "" SWORD front_0505_CM_int16 0 0 -32768 32767 ECU_ADDRESS 0x500002d4 /* @ECU_Address@FL_Actual_Velocity@ */ /end MEASUREMENT
/begin MEASUREMENT FR_Actual_Velocity "" SWORD front_0505_CM_int16 0 0 -32768 32767 ECU_ADDRESS 0x500002b4 /* @ECU_Address@FR_Actual_Velocity@ */ /end MEASUREMENT
/begin MEASUREMENT torque_output "" SWORD front_0505_CM_int16 0 0 -32768 32767 ECU_ADDRESS 0x50000200 /* @ECU_Address@torque_output@ */ /end MEASUREMENT
/begin MEASUREMENT RL_Actual_Velocity "" SWORD front_0505_CM_int16 0 0 -32768 32767 ECU_ADDRESS 0x50000278 /* @ECU_Address@RL_Actual_Velocity@ */ /end MEASUREMENT
/begin MEASUREMENT RR_Actual_Velocity "" SWORD front_0505_CM_int16 0 0 -32768 32767 ECU_ADDRESS 0x50000258 /* @ECU_Address@RR_Actual_Velocity@ */ /end MEASUREMENT
/begin MEASUREMENT ready_rr "" SWORD front_0505_CM_int16 0 0 -32768 32767 ECU_ADDRESS 0x5000020c /* @ECU_Address@ready_rr@ */ /end MEASUREMENT
/begin MEASUREMENT ready_rl "" SWORD front_0505_CM_int16 0 0 -32768 32767 ECU_ADDRESS 0x5000020e /* @ECU_Address@ready_rl@ */ /end MEASUREMENT
/begin MEASUREMENT ready_fr "" SWORD front_0505_CM_int16 0 0 -32768 32767 ECU_ADDRESS 0x50000210 /* @ECU_Address@ready_fr@ */ /end MEASUREMENT
/begin MEASUREMENT ready_fl "" SWORD front_0505_CM_int16 0 0 -32768 32767 ECU_ADDRESS 0x50000212 /* @ECU_Address@ready_fl@ */ /end MEASUREMENT
/begin MEASUREMENT FL_DCon "" UBYTE front_0505_CM_boolean 0 0 0 1 ECU_ADDRESS 0x500002d3 /* @ECU_Address@FL_DCon@ */ /end MEASUREMENT
/begin MEASUREMENT FL_Quit_Inverter_on "" UBYTE front_0505_CM_boolean 0 0 0 1 ECU_ADDRESS 0x500002cd /* @ECU_Address@FL_Quit_Inverter_on@ */ /end MEASUREMENT
/begin MEASUREMENT FL_Error "" UBYTE front_0505_CM_boolean 0 0 0 1 ECU_ADDRESS 0x500002d2 /* @ECU_Address@FL_Error@ */ /end MEASUREMENT
/begin MEASUREMENT FL_QuitDCon "" UBYTE front_0505_CM_boolean 0 0 0 1 ECU_ADDRESS 0x500002ce /* @ECU_Address@FL_QuitDCon@ */ /end MEASUREMENT
/begin MEASUREMENT FL_Inverter_on "" UBYTE front_0505_CM_boolean 0 0 0 1 ECU_ADDRESS 0x500002cf /* @ECU_Address@FL_Inverter_on@ */ /end MEASUREMENT
/begin MEASUREMENT FL_System_Ready "" UBYTE front_0505_CM_boolean 0 0 0 1 ECU_ADDRESS 0x500002cc /* @ECU_Address@FL_System_Ready@ */ /end MEASUREMENT
/begin MEASUREMENT FL_Warning "" UBYTE front_0505_CM_boolean 0 0 0 1 ECU_ADDRESS 0x500002bc /* @ECU_Address@FL_Warning@ */ /end MEASUREMENT
/begin MEASUREMENT FR_DCon "" UBYTE front_0505_CM_boolean 0 0 0 1 ECU_ADDRESS 0x500002b3 /* @ECU_Address@FR_DCon@ */ /end MEASUREMENT
/begin MEASUREMENT FR_Quit_Inverter_on "" UBYTE front_0505_CM_boolean 0 0 0 1 ECU_ADDRESS 0x500002ad /* @ECU_Address@FR_Quit_Inverter_on@ */ /end MEASUREMENT
/begin MEASUREMENT FR_Error "" UBYTE front_0505_CM_boolean 0 0 0 1 ECU_ADDRESS 0x500002b2 /* @ECU_Address@FR_Error@ */ /end MEASUREMENT
/begin MEASUREMENT FR_QuitDCon "" UBYTE front_0505_CM_boolean 0 0 0 1 ECU_ADDRESS 0x500002ae /* @ECU_Address@FR_QuitDCon@ */ /end MEASUREMENT
/begin MEASUREMENT FR_Inverter_on "" UBYTE front_0505_CM_boolean 0 0 0 1 ECU_ADDRESS 0x500002af /* @ECU_Address@FR_Inverter_on@ */ /end MEASUREMENT
/begin MEASUREMENT FR_System_Ready "" UBYTE front_0505_CM_boolean 0 0 0 1 ECU_ADDRESS 0x500002ac /* @ECU_Address@FR_System_Ready@ */ /end MEASUREMENT
/begin MEASUREMENT FR_Warning "" UBYTE front_0505_CM_boolean 0 0 0 1 ECU_ADDRESS 0x5000029d /* @ECU_Address@FR_Warning@ */ /end MEASUREMENT
/begin MEASUREMENT SC_Closed "" UBYTE front_0505_CM_boolean 0 0 0 1 ECU_ADDRESS 0x50000240 /* @ECU_Address@SC_Closed@ */ /end MEASUREMENT
/begin MEASUREMENT Ready "" UBYTE front_0505_CM_boolean 0 0 0 1 ECU_ADDRESS 0x50000241 /* @ECU_Address@Ready@ */ /end MEASUREMENT
/begin MEASUREMENT buzzer "" UBYTE front_0505_CM_boolean 0 0 0 1 ECU_ADDRESS 0x50000218 /* @ECU_Address@buzzer@ */ /end MEASUREMENT
/begin MEASUREMENT RL_DCon "" UBYTE front_0505_CM_boolean 0 0 0 1 ECU_ADDRESS 0x50000277 /* @ECU_Address@RL_DCon@ */ /end MEASUREMENT
/begin MEASUREMENT RL_Quit_Inverter_on "" UBYTE front_0505_CM_boolean 0 0 0 1 ECU_ADDRESS 0x50000271 /* @ECU_Address@RL_Quit_Inverter_on@ */ /end MEASUREMENT
/begin MEASUREMENT RL_Error "" UBYTE front_0505_CM_boolean 0 0 0 1 ECU_ADDRESS 0x50000276 /* @ECU_Address@RL_Error@ */ /end MEASUREMENT
/begin MEASUREMENT RL_QuitDCon "" UBYTE front_0505_CM_boolean 0 0 0 1 ECU_ADDRESS 0x50000272 /* @ECU_Address@RL_QuitDCon@ */ /end MEASUREMENT
/begin MEASUREMENT RL_Inverter_on "" UBYTE front_0505_CM_boolean 0 0 0 1 ECU_ADDRESS 0x50000273 /* @ECU_Address@RL_Inverter_on@ */ /end MEASUREMENT
/begin MEASUREMENT RL_System_Ready "" UBYTE front_0505_CM_boolean 0 0 0 1 ECU_ADDRESS 0x50000270 /* @ECU_Address@RL_System_Ready@ */ /end MEASUREMENT
/begin MEASUREMENT RL_Warning "" UBYTE front_0505_CM_boolean 0 0 0 1 ECU_ADDRESS 0x50000260 /* @ECU_Address@RL_Warning@ */ /end MEASUREMENT
/begin MEASUREMENT RR_DCon "" UBYTE front_0505_CM_boolean 0 0 0 1 ECU_ADDRESS 0x50000257 /* @ECU_Address@RR_DCon@ */ /end MEASUREMENT
/begin MEASUREMENT RR_Quit_Inverter_on "" UBYTE front_0505_CM_boolean 0 0 0 1 ECU_ADDRESS 0x50000251 /* @ECU_Address@RR_Quit_Inverter_on@ */ /end MEASUREMENT
/begin MEASUREMENT RR_Error "" UBYTE front_0505_CM_boolean 0 0 0 1 ECU_ADDRESS 0x50000256 /* @ECU_Address@RR_Error@ */ /end MEASUREMENT
/begin MEASUREMENT RR_QuitDCon "" UBYTE front_0505_CM_boolean 0 0 0 1 ECU_ADDRESS 0x50000252 /* @ECU_Address@RR_QuitDCon@ */ /end MEASUREMENT
/begin MEASUREMENT RR_Inverter_on "" UBYTE front_0505_CM_boolean 0 0 0 1 ECU_ADDRESS 0x50000253 /* @ECU_Address@RR_Inverter_on@ */ /end MEASUREMENT
/begin MEASUREMENT RR_System_Ready "" UBYTE front_0505_CM_boolean 0 0 0 1 ECU_ADDRESS 0x50000250 /* @ECU_Address@RR_System_Ready@ */ /end MEASUREMENT
/begin MEASUREMENT RR_Warning "" UBYTE front_0505_CM_boolean 0 0 0 1 ECU_ADDRESS 0x50000242 /* @ECU_Address@RR_Warning@ */ /end MEASUREMENT
/begin MEASUREMENT HV_Enable "" UBYTE front_0505_CM_boolean 0 0 0 1 ECU_ADDRESS 0x5000029c /* @ECU_Address@HV_Enable@ */ /end MEASUREMENT
/begin MEASUREMENT Invertor_Enable "" UBYTE front_0505_CM_boolean 0 0 0 1 ECU_ADDRESS 0x50000294 /* @ECU_Address@Invertor_Enable@ */ /end MEASUREMENT
/begin MEASUREMENT DCDC_enable "" UBYTE front_0505_CM_boolean 0 0 0 1 ECU_ADDRESS 0x500002e0 /* @ECU_Address@DCDC_enable@ */ /end MEASUREMENT
/begin COMPU_METHOD front_0505_CM_boolean "Q = V" RAT_FUNC "%1.0" "" COEFFS 0 1 0 0 0 1 /end COMPU_METHOD
/begin COMPU_METHOD front_0505_CM_single "Q = V" RAT_FUNC "%8.6" "" COEFFS 0 1 0 0 0 1 /end COMPU_METHOD
/begin COMPU_METHOD front_0505_CM_uint16 "Q = V" RAT_FUNC "%5.0" "" COEFFS 0 1 0 0 0 1 /end COMPU_METHOD
/begin COMPU_METHOD front_0505_CM_int16 "Q = V" RAT_FUNC "%5.0" "" COEFFS 0 1 0 0 0 1 /end COMPU_METHOD
/begin GROUP front_0505 "front_0505" /* Root */ ROOT /begin SUB_GROUP Root_CAN Root_Channel_Read Root_Channnel_Out Root_Control /end SUB_GROUP /end GROUP
/begin GROUP Root_CAN "front_0505/CAN" /begin SUB_GROUP S1_CAN_Read S1_CAN_Write /end SUB_GROUP /end GROUP
/begin GROUP Root_Channel_Read "front_0505/Channel Read" /begin SUB_GROUP S2_ADC S2_DI S2_Multi_geer_knob /end SUB_GROUP /end GROUP
/begin GROUP Root_Channnel_Out "front_0505/Channnel Out" /begin SUB_GROUP S3_DC_ S3____ /end SUB_GROUP /end GROUP
/begin GROUP Root_Control "front_0505/Control" /begin SUB_GROUP S4_Motor_Enable S4_StateMachine S4_Torque_Control /end SUB_GROUP /end GROUP
/begin GROUP S1_CAN_Read "front_0505/CAN/CAN Read" /begin SUB_GROUP S8_Motor_CAN /end SUB_GROUP /end GROUP
/begin GROUP S1_CAN_Write "front_0505/CAN/CAN Write" /begin SUB_GROUP S9_Send_To_Inverter /end SUB_GROUP /end GROUP
/begin GROUP S2_ADC "front_0505/Channel Read/ADC"
 /begin SUB_GROUP S72_ADC_Reading_ S72_DCDC_temp S72______ S72________ S72_________ /end SUB_GROUP
/end GROUP
/begin GROUP S2_DI "front_0505/Channel Read/DI" /begin REF_MEASUREMENT SC_Closed /end REF_MEASUREMENT /end GROUP
/begin GROUP S2_Multi_geer_knob "front_0505/Channel Read/Multi_geer_knob" /begin SUB_GROUP S74_ADC_Value_To_Volt /end SUB_GROUP /begin REF_MEASUREMENT Multi_gear_knob /end REF_MEASUREMENT /end GROUP
/begin GROUP S3_DC_ "front_0505/Channnel Out/DC板" /begin REF_MEASUREMENT DCDC_enable /end REF_MEASUREMENT /end GROUP
/begin GROUP S3____ "front_0505/Channnel Out/蜂鸣器" /begin REF_MEASUREMENT buzzer /end REF_MEASUREMENT /end GROUP
/begin GROUP S4_Motor_Enable "front_0505/Control/Motor_Enable" /begin REF_MEASUREMENT Ready ready_fl ready_fr ready_rl ready_rr /end REF_MEASUREMENT /end GROUP
/begin GROUP S4_StateMachine "front_0505/Control/StateMachine" /begin REF_MEASUREMENT HV_Enable Invertor_Enable Vehicle_Status /end REF_MEASUREMENT /end GROUP
/begin GROUP S4_Torque_Control "front_0505/Control/Torque_Control"
 /begin SUB_GROUP S131_Subsystem S131_Subsystem1 S131_Subsystem4 S131_Subsystem5 /end SUB_GROUP
 /begin REF_MEASUREMENT actual_velocity percent_out torque_output /end REF_MEASUREMENT
/end GROUP
/begin GROUP S8_Motor_CAN "front_0505/CAN/CAN Read/Motor_CAN"
 /begin REF_MEASUREMENT FL_Actual_Torque FL_Actual_Velocity FL_DCon FL_Error FL_Error_Info FL_Inverter_on FL_QuitDCon FL_Quit_Inverter_on FL_System_Ready FL_TempIGBT FL_TempInverter FL_TempMotor FL_Warning FR_Actual_Torque FR_Actual_Velocity FR_DCon FR_Error FR_Error_Info FR_Inverter_on FR_QuitDCon FR_Quit_Inverter_on FR_System_Ready FR_TempIGBT FR_TempInverter FR_TempMotor FR_Warning RL_Actual_Torque RL_Actual_Velocity RL_DCon RL_Error RL_Error_Info RL_Inverter_on RL_QuitDCon RL_Quit_Inverter_on RL_System_Ready RL_TempIGBT RL_TempInverter RL_TempMotor RL_Warning RR_Actual_Torque RR_Actual_Velocity RR_DCon RR_Error RR_Error_Info RR_Inverter_on RR_QuitDCon RR_Quit_Inverter_on RR_System_Ready RR_TempIGBT RR_TempInverter RR_TempMotor RR_Warning /end REF_MEASUREMENT
/end GROUP
/begin GROUP S9_Send_To_Inverter "front_0505/CAN/CAN Write/Send_To_Inverter" /begin REF_CHARACTERISTIC errorset /end REF_CHARACTERISTIC /end GROUP
/begin GROUP S72_ADC_Reading_ "front_0505/Channel Read/ADC/ADC Reading "
 /begin SUB_GROUP S75_ADC_Value_To_Volt S75_Accelerate_Pedal S75_Brake_Pedal1 S75_LV_Battery_Voltage S75_Pedal_out1 /end SUB_GROUP
 /begin REF_MEASUREMENT ACC_per_h ACC_per_l brake_per_1 brake_per_2 /end REF_MEASUREMENT
/end GROUP
/begin GROUP S72_DCDC_temp "front_0505/Channel Read/ADC/DCDC_temp" /begin SUB_GROUP S76_ADC_Value_To_Volt /end SUB_GROUP /end GROUP
/begin GROUP S72________ "front_0505/Channel Read/ADC/安全回路模拟量" /begin SUB_GROUP S77_ADC_Value_To_Volt /end SUB_GROUP /end GROUP
/begin GROUP S72_________ "front_0505/Channel Read/ADC/方向盘转角传感器" /begin SUB_GROUP S78_ADC_Value_To_Volt /end SUB_GROUP /begin REF_MEASUREMENT steering_angle /end REF_MEASUREMENT /end GROUP
/begin GROUP S72______ "front_0505/Channel Read/ADC/电流传感器" /begin SUB_GROUP S79_ADC_Value_To_Volt /end SUB_GROUP /end GROUP
/begin GROUP S74_ADC_Value_To_Volt "front_0505/Channel Read/Multi_geer_knob/ADC Value To Volt" /begin REF_MEASUREMENT KNOB_VOLTAGE /end REF_MEASUREMENT /end GROUP
/begin GROUP S131_Subsystem "front_0505/Control/Torque_Control/Subsystem" /begin REF_MEASUREMENT Torque_Set_FL /end REF_MEASUREMENT /end GROUP
/begin GROUP S131_Subsystem1 "front_0505/Control/Torque_Control/Subsystem1" /begin REF_MEASUREMENT Torque_Set_FR /end REF_MEASUREMENT /end GROUP
/begin GROUP S131_Subsystem4 "front_0505/Control/Torque_Control/Subsystem4" /begin REF_MEASUREMENT Torque_Set_RL /end REF_MEASUREMENT /end GROUP
/begin GROUP S131_Subsystem5 "front_0505/Control/Torque_Control/Subsystem5" /begin REF_MEASUREMENT Torque_Set_RR /end REF_MEASUREMENT /end GROUP
/begin GROUP S75_ADC_Value_To_Volt "front_0505/Channel Read/ADC/ADC Reading /ADC Value To Volt" /begin REF_MEASUREMENT Brake_angle_volt /end REF_MEASUREMENT /end GROUP
/begin GROUP S75_Accelerate_Pedal "front_0505/Channel Read/ADC/ADC Reading /Accelerate Pedal" /begin SUB_GROUP S81_ADC_Value_To_Volt S81_ADC_Value_To_Volt1 /end SUB_GROUP /end GROUP
/begin GROUP S75_Brake_Pedal1 "front_0505/Channel Read/ADC/ADC Reading /Brake Pedal1" /begin SUB_GROUP S82_ADC_Value_To_Volt1 S82_ADC_Value_To_Volt2 /end SUB_GROUP /end GROUP
/begin GROUP S75_LV_Battery_Voltage "front_0505/Channel Read/ADC/ADC Reading /LV Battery Voltage" /begin SUB_GROUP S83_ADC_Value_To_Volt /end SUB_GROUP /end GROUP
/begin GROUP S75_Pedal_out1 "front_0505/Channel Read/ADC/ADC Reading /Pedal_out1" /begin REF_MEASUREMENT Pedal_Unreliable Pedal_percent /end REF_MEASUREMENT /end GROUP
/begin GROUP S76_ADC_Value_To_Volt "front_0505/Channel Read/ADC/DCDC_temp/ADC Value To Volt" /begin REF_MEASUREMENT DCDC_temp /end REF_MEASUREMENT /end GROUP
/begin GROUP S77_ADC_Value_To_Volt "front_0505/Channel Read/ADC/安全回路模拟量/ADC Value To Volt" /begin REF_MEASUREMENT SC_statement /end REF_MEASUREMENT /end GROUP
/begin GROUP S78_ADC_Value_To_Volt "front_0505/Channel Read/ADC/方向盘转角传感器/ADC Value To Volt" /begin REF_MEASUREMENT steering_volt /end REF_MEASUREMENT /end GROUP
/begin GROUP S79_ADC_Value_To_Volt "front_0505/Channel Read/ADC/电流传感器/ADC Value To Volt" /begin REF_MEASUREMENT I /end REF_MEASUREMENT /end GROUP
/begin GROUP S81_ADC_Value_To_Volt "front_0505/Channel Read/ADC/ADC Reading /Accelerate Pedal/ADC Value To Volt" /begin REF_MEASUREMENT ACC_Pedal_ADC1 /end REF_MEASUREMENT /end GROUP
/begin GROUP S81_ADC_Value_To_Volt1 "front_0505/Channel Read/ADC/ADC Reading /Accelerate Pedal/ADC Value To Volt1" /begin REF_MEASUREMENT ACC_Pedal_ADC2 /end REF_MEASUREMENT /end GROUP
/begin GROUP S82_ADC_Value_To_Volt1 "front_0505/Channel Read/ADC/ADC Reading /Brake Pedal1/ADC Value To Volt1" /begin REF_MEASUREMENT brake_voltage__2 /end REF_MEASUREMENT /end GROUP
/begin GROUP S82_ADC_Value_To_Volt2 "front_0505/Channel Read/ADC/ADC Reading /Brake Pedal1/ADC Value To Volt2" /begin REF_MEASUREMENT brake_voltage__1 /end REF_MEASUREMENT /end GROUP
/begin GROUP S83_ADC_Value_To_Volt "front_0505/Channel Read/ADC/ADC Reading /LV Battery Voltage/ADC Value To Volt" /begin REF_MEASUREMENT LV_volt /end REF_MEASUREMENT /end GROUP
/end MODULE
/end PROJECT
/* (add any file trailer comments here) */
/* EOF front_0505.a2l */
